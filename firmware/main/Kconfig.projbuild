## firmware/main/Kconfig.projbuild
```kconfig
menu "Blue Baton settings"

    config KM_DIAG
        bool "Developer diagnostics (stats details, self-test)"
        default n
        help
            Per-host delivery statistics in the stats command (times from input to completion, signal strength,
            reports the stack could not take, settings flash writes) and the selftest command. Off in release builds
            (the code is compiled out and stats keeps only the basic fields); tools/flash.sh builds with it on
            (sdkconfig.dev).

endmenu
```
